## app/module/dts/bindings/test-behaviors/zmk,behavior_discard_keymap_changes.yaml
```yaml
# Copyright (c) 2026 The ZMK Contributors
# SPDX-License-Identifier: MIT

description: Keymap Discard Changes Behavior

compatible: "zmk,behavior-discard-keymap-changes"

include: zero_param.yaml
```

## app/module/dts/bindings/test-behaviors/zmk,behavior_keymap_changes.yaml
```yaml
# Copyright (c) 2026 The ZMK Contributors
# SPDX-License-Identifier: MIT

description: |
  Keymap changes behavior. The parameter selects the operation:
  0 = discard pending changes, 1 = save changes, 2 = reset to stock settings,
  3 = store key and sensor binding settings for an out of range layer (stale settings).

compatible: "zmk,behavior-keymap-changes"

include: one_param.yaml
```

## app/module/dts/bindings/test-behaviors/zmk,behavior_set_layer_sensor_binding.yaml
```yaml
# Copyright (c) 2026 The ZMK Contributors
# SPDX-License-Identifier: MIT

description: Layer Sensor Binding Setter Behavior

compatible: "zmk,behavior-set-layer-sensor-binding"

include: two_param.yaml

properties:
  sensor-bindings:
    type: phandle-array
    required: true
  clear:
    type: boolean
    description: Clear the sensor binding instead of setting one from sensor-bindings
```
